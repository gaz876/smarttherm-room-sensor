## main/Kconfig.projbuild
```kconfig
menu "Room sensor"
config ROOM_SAMPLE_INTERVAL_S
    int "Measurement interval (seconds)"
    range 1 3600
    default 10
config ROOM_I2C_SDA
    int "SDA GPIO (fixed provisional SuperMini profile)"
    range 4 4
    default 4
config ROOM_I2C_SCL
    int "SCL GPIO (fixed provisional SuperMini profile)"
    range 5 5
    default 5
config ROOM_WIFI_HMAC_KEY_ID
    int "Previously provisioned HMAC key ID (-1 disables Wi-Fi)"
    range -1 5
    default -1
    help
        Experimental only. Select an approved existing protected key; never creates a key.
endmenu
```

## sdkconfig.defaults
```kconfig
CONFIG_ESPTOOLPY_FLASHSIZE_4MB=y
CONFIG_PARTITION_TABLE_CUSTOM=y
CONFIG_PARTITION_TABLE_CUSTOM_FILENAME="main/partitions.csv"
# CONFIG_NVS_ENCRYPTION is not set
CONFIG_ROOM_WIFI_HMAC_KEY_ID=-1

# Footprint candidate: no plaintext/legacy protocomm modes.
# CONFIG_ESP_PROTOCOMM_SUPPORT_SECURITY_VERSION_0 is not set
# CONFIG_ESP_PROTOCOMM_SUPPORT_SECURITY_VERSION_1 is not set
CONFIG_ESP_PROTOCOMM_SUPPORT_SECURITY_VERSION_2=y
```

## tests/http_backend_sdk_probe/sdkconfig.defaults
```kconfig
CONFIG_LWIP_NETIF_LOOPBACK=y
CONFIG_LWIP_IPV6=y
CONFIG_ESP_SYSTEM_PANIC_PRINT_HALT=y
```
